## config/west.yml
```yaml
manifest:
  remotes:
    - name: zmkfirmware
      url-base: https://github.com/zmkfirmware
  projects:
    - name: zmk
      remote: zmkfirmware
      revision: main
      import: app/west.yml
  self:
    path: config
  include:
  - board: nice_nano_v2
    shield: kyria_rev2_left
  - board: nice_nano_v2
    shield: kyria_rev2_right
  - board: nice_nano_v2
    shield: settings_reset
```
